## meta-imx6ull-barebones/conf/layer.conf
```bitbake
# We have a conf and classes directory, add to BBPATH
BBPATH .= ":${LAYERDIR}"

# We have recipes-* directories, add to BBFILES
BBFILES += "${LAYERDIR}/recipes-*/*.bb \
            ${LAYERDIR}/recipes-*/*.bbappend \
            ${LAYERDIR}/recipes-*/*/*.bb \
            ${LAYERDIR}/recipes-*/*/*.bbappend"

BBFILE_COLLECTIONS += "meta-imx6ull-barebones"
BBFILE_PATTERN_meta-imx6ull-barebones = "^${LAYERDIR}/"
BBFILE_PRIORITY_meta-imx6ull-barebones = "6"

LAYERDEPENDS_meta-imx6ull-barebones = "core"
LAYERSERIES_COMPAT_meta-imx6ull-barebones = "whinlatter"
```

## meta-imx6ull-barebones/conf/machine/imx6ull-barebones.conf
```bitbake
#@TYPE: Machine
#@NAME: i.MX6ULL Bare Bones
#@SOC: i.MX6ULL
#@DESCRIPTION: Machine configuration for i.MX6ULL Bare Bones project
#@MAINTAINER: Andrew Wolfe <awolfe196@gmail.com>

MACHINEOVERRIDES =. "mx6:mx6ul:mx6ull:"

include conf/machine/include/imx-base.inc
include conf/machine/include/arm/armv7a/tune-cortexa7.inc

KERNEL_DEVICETREE = "nxp/imx/imx6ull-barebones.dtb" 

UBOOT_CONFIG ??= "${@bb.utils.contains('MACHINE_FEATURES', 'optee', 'sd-optee', 'sd', d)}"
UBOOT_CONFIG[sd] = "mx6ull_14x14_evk_config,sdcard"
UBOOT_CONFIG[emmc] = "mx6ull_14x14_evk_emmc_config,sdcard"
UBOOT_CONFIG[nand] = "mx6ull_14x14_evk_nand_config,ubifs"
UBOOT_CONFIG[qspi1] = "mx6ull_14x14_evk_qspi1_config"
UBOOT_CONFIG[sd-optee] = "mx6ull_14x14_evk_optee_config,sdcard"

OPTEE_BIN_EXT = "6ullevk"

MACHINE_FEATURES = ""
```
